## config/west.yml
```yaml
manifest:
  defaults:
    # ZMK 0.4 pre-release: track main until v0.4 is tagged, then re-pin.
    revision: main
  remotes:
    - name: zmkfirmware
      url-base: https://github.com/zmkfirmware
    - name: caksoylar
      url-base: https://github.com/caksoylar
    - name: carrefinho
      url-base: https://github.com/carrefinho
  projects:
    - name: zmk
      remote: zmkfirmware
      import: app/west.yml
    # cirque-input-module removed: Zephyr 4.1 ships a native cirque,pinnacle driver.
    - name: zmk-rgbled-widget
      remote: caksoylar
      revision: main
    - name: prospector-zmk-module
      remote: carrefinho
      revision: feat/new-status-screens
  self:
    path: config
```
