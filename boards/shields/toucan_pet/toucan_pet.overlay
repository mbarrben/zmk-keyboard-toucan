/*
 * Copyright (c) 2022 The ZMK Contributors
 *
 * SPDX-License-Identifier: MIT
 */

&nice_view_spi {
    status = "okay";
    nice_view: ls0xx@0 {
        compatible = "sharp,ls0xx";
        spi-max-frequency = <1000000>;
        reg = <0>;
        width = <144>;
        height = <168>;
        /* No EXTCOMIN pin wired, so VCOM must be inverted over SPI instead;
         * otherwise a static image left up for a long time causes DC-bias
         * image sticking on this panel. */
        serial-vcom-inversion;
    };
};

/ {
    chosen {
        zephyr,display = &nice_view;
    };
};
