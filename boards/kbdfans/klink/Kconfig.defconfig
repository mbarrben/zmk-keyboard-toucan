## boards/kbdfans/klink/Kconfig.defconfig
```kconfig
if BOARD_KLINK

config ZMK_KEYBOARD_NAME
    default "klink"

if USB

config USB_NRFX
    default y

config USB_DEVICE_STACK
    default y

endif # USB

config BT_CTLR
    default BT

endif # BOARD_KLINK
```

## boards/shields/toucan_bt60/Kconfig.defconfig
```kconfig
if SHIELD_TOUCAN_BT60

config ZMK_SPLIT
    default y

config ZMK_SPLIT_ROLE_CENTRAL
    default n

endif
```

## boards/shields/toucan_tofu65/Kconfig.defconfig
```kconfig
if SHIELD_TOUCAN_TOFU65

config ZMK_SPLIT
    default y

config ZMK_SPLIT_ROLE_CENTRAL
    default n

# 74HC595 column shifter on SPI0.
config SPI
    default y

endif
```

## dts/bindings/behaviors/zmk,behavior-tofu65-indicators.yaml
```yaml
# SPDX-License-Identifier: MIT
description: >
  Tofu65 indicator LED state. The prospector dongle invokes it on the Tofu65 with
  param1 = HID indicator bitmap (HID_INDICATOR_* from dt-bindings/zmk/hid_indicators.h).

compatible: "zmk,behavior-tofu65-indicators"

include: one_param.yaml
```
